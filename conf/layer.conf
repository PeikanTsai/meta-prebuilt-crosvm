## conf/layer.conf
```bitbake
# We have a conf and classes directory, add to BBPATH
BBPATH .= ":${LAYERDIR}"

# We have recipes-* directories, add to BBFILES
BBFILES += "${LAYERDIR}/recipes-*/*/*.bb \
            ${LAYERDIR}/recipes-*/*/*.bbappend"

BBFILE_COLLECTIONS += "meta-prebuilt-crosvm"
BBFILE_PATTERN_meta-prebuilt-crosvm = "^${LAYERDIR}/"
BBFILE_PRIORITY_meta-prebuilt-crosvm = "6"

# net related module for tuntap configuration
KERNEL_MODULE_AUTOLOAD += " tun nf_nat ip_tables iptable_nat ipt_MASQUERADE xt_state"

LAYERDEPENDS_meta-prebuilt-crosvm = "core"
LAYERSERIES_COMPAT_meta-prebuilt-crosvm = "mickledore"
```
